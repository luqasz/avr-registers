# ATmega324PB device description
Architecture: AVR8; Family: megaAVR
Programming and debug interfaces: ISP, HVPP, JTAG
Registers are 8-bit, access not given, no defined reset value unless marked. A register's access mark holds for its fields unless they carry their own. Offsets are from the block's base; lines under a group give offsets from that group; [hi:lo] are bit positions; {n}, {i} and the like mark numbered series; 'fields as' and 'values as' point back to an identical list; <NAME> marks a mode.

## Ordering variants
ATmega324PB-AU, ATmega324PB-AUR: TQFP44, up to 20 MHz, -40 to 85 C, 1.8 to 5.5 V
ATmega324PB-MU, ATmega324PB-MUR: VQFN44, up to 20 MHz, -40 to 85 C, 1.8 to 5.5 V
ATmega324PB-AN, ATmega324PB-ANR: TQFP44, up to 20 MHz, -40 to 105 C, 1.8 to 5.5 V
ATmega324PB-MN, ATmega324PB-MNR: VQFN44, up to 20 MHz, -40 to 105 C, 1.8 to 5.5 V

## Memory
prog space: start 0x0000 size 0x8000, little endian
  0x0000 FLASH size 0x8000 flash, rw, executable, page 0x80
  0x7e00 BOOT_SECTION_1 size 0x0200 flash, rw, executable, page 0x80
  0x7c00 BOOT_SECTION_2 size 0x0400 flash, rw, executable, page 0x80
  0x7800 BOOT_SECTION_3 size 0x0800 flash, rw, executable, page 0x80
  0x7000 BOOT_SECTION_4 size 0x1000 flash, rw, executable, page 0x80
signatures space: start 0 size 3, little endian
  0 SIGNATURES size 3 signatures, ro
fuses space: start 0 size 0x0003, little endian
  0 FUSES size 0x0003 fuses, rw
lockbits space: start 0 size 0x0001, little endian
  0 LOCKBITS size 0x0001 lockbits, rw
data space: start 0x0000 size 0x0900, little endian
  0x0000 REGISTERS size 0x0020 regs
  0x0020 MAPPED_IO size 0x00e0 io
  0x0100 IRAM size 0x0800 ram
eeprom space: start 0x0000 size 0x0400, little endian
  0x0000 EEPROM size 0x0400 eeprom, rw, page 0x04
io space: start 0x00 size 0x40, little endian
osccal space: start 0 size 1, little endian
  0 OSCCAL size 1 osccal, ro

## Peripheral instances (address, pins/pin function, parameters)
AC at 0x00 — Analog Comparator
  pins: AC PC5; AIN0 PB2; AIN1 PB3
USART0 at 0x00 — USART
  pins: TXD PD1; RXD PD0; XCK PB0
USART1 at 0x00 — USART
  pins: TXD PD3; RXD PD2; XCK PD4
USART2 at 0x00 — USART
  pins: TXD PE3; RXD PE2; XCK PD7
PORTA at 0x00 — I/O Port
  pins: PORTA{n} PA{n} (n=0..7)
PORTB at 0x00 — I/O Port
  pins: PORTB{n} PB{n} (n=0..7)
PORTC at 0x00 — I/O Port
  pins: PORTC{n} PC{n} (n=0..7)
PORTD at 0x00 — I/O Port
  pins: PORTD{n} PD{n} (n=0..7)
PORTE at 0x00 — I/O Port
  pins: PORTE0 PE0; PORTE1 PE1; PORTE2 PE2; PORTE3 PE3; PORTE4 PE4; PORTE5 PE5; PORTE6 PE6
TC0 at 0x00 — Timer/Counter, 8-bit
  pins: T PB0; OCB PB4; OCA PB3
TC1 at 0x00 — Timer/Counter, 16-bit
  pins: T PB1; ICP PD6; OCA PD5; OCB PD4
TC3 at 0x00 — Timer/Counter, 16-bit
  pins: T PD0; ICP PB5; OCA PB6; OCB PB7
TC4 at 0x00 — Timer/Counter, 16-bit
  pins: T PC2; ICP PC3; OCA PC4; OCB PB7
TC2 at 0x00 — Timer/Counter, 8-bit Async
  pins: OCA PD7; OCB PD6
WDT at 0x00 — Watchdog Timer
PTC — Peripheral Touch Controller
  pins: X{n} PD{n} (n=0..7); X8 PE2; X9 PE3; X10 PC0; X11 PC1; X12 PC2; X13 PC3; X14 PC4; X15 PC5; Y{n} PA{n} (n=0..7); Y{n} PD{n-8} (n=8..15); Y16 PE2; Y17 PE3; Y18 PC0; Y19 PC1; Y20 PC2; Y21 PC3; Y22 PC4; Y23 PC5; Y{n} PB{n-24} (n=24..31)
JTAG at 0x00 — JTAG Interface
  pins: TCK PC2; TMS PC3; TDO PC4; TDI PC5
EXINT at 0x00 — External Interrupts
  pins: PCINT{n} PA{n} (n=0..7); PCINT{n} PB{n-8} (n=8..15); PCINT{n} PC{n-16} (n=16..23); PCINT{n} PD{n-24} (n=24..31); PCINT32 PE0; PCINT33 PE1; INT0 PD2; INT1 PD3; INT2 PB2
ADC at 0x00 — Analog-to-Digital Converter
  pins: ADC{n} PA{n} (n=0..7)
EEPROM at 0x00
SPI0 at 0x00 — Serial Peripheral Interface
  pins: SS PB4; MOSI PB5; MISO PB6; SCK PB7
SPI1 at 0x00 — Serial Peripheral Interface
  pins: SS PD6; SCK PD7; MISO PE2; MOSI PE3
TWI0 at 0x00 — Two Wire Serial Interface
  pins: SDA0 PC1; SCL0 PC0
TWI1 at 0x00 — Two Wire Serial Interface
  pins: SDA1 PE5; SCL1 PE6
CFD at 0x00 — Clock Failure Detection
CPU at 0x00 — CPU Registers
  pins: CLK0 PB1
FUSE at 0 in fuses — Fuses
LOCKBIT at 0 in lockbits — Lockbits

## Interrupts
0 RESET — External Pin,Power-on Reset,Brown-out Reset,Watchdog Reset,and JTAG AVR Reset. See Datasheet.
1 INT0 — External Interrupt Request 0
2 INT1 — External Interrupt Request 1
3 INT2 — External Interrupt Request 2
4 PCINT0 — Pin Change Interrupt Request 0
5 PCINT1 — Pin Change Interrupt Request 1
6 PCINT2 — Pin Change Interrupt Request 2
7 PCINT3 — Pin Change Interrupt Request 3
8 WDT — Watchdog Time-out Interrupt
9 TIMER2_COMPA — Timer/Counter2 Compare Match A
10 TIMER2_COMPB — Timer/Counter2 Compare Match B
11 TIMER2_OVF — Timer/Counter2 Overflow
12 TIMER1_CAPT — Timer/Counter1 Capture Event
13 TIMER1_COMPA — Timer/Counter1 Compare Match A
14 TIMER1_COMPB — Timer/Counter1 Compare Match B
15 TIMER1_OVF — Timer/Counter1 Overflow
16 TIMER0_COMPA — Timer/Counter0 Compare Match A
17 TIMER0_COMPB — Timer/Counter0 Compare Match B
18 TIMER0_OVF — Timer/Counter0 Overflow
19 SPI0_STC — SPI0 Serial Transfer Complete
20 USART0_RX — USART0 Rx Complete
21 USART0_UDRE — USART0 Data register Empty
22 USART0_TX — USART0 Tx Complete
23 ANALOG_COMP — Analog Comparator
24 ADC — ADC Conversion Complete
25 EE_READY — EEPROM Ready
26 TWI0 — 2-wire Serial Interface 0
27 SPM_READY — Store Program Memory Read
28 USART1_RX — USART1 RX complete
29 USART1_UDRE — USART1 Data Register Empty
30 USART1_TX — USART1 TX complete
31 TIMER3_CAPT — Timer/Counter3 Capture Event
32 TIMER3_COMPA — Timer/Counter3 Compare Match A
33 TIMER3_COMPB — Timer/Counter3 Compare Match B
34 TIMER3_OVF — Timer/Counter3 Overflow
35 USART0_RXS — USART0 RX start edge detect
35 USART0_START — USART0 RX start edge detect
36 USART1_RXS — USART1 RX start edge detect
36 USART1_START — USART1 RX start edge detect
37 PCINT4 — Pin Change Interrupt Request 4
38 XOSCFD — Crystal failure detect
39 PTC_EOC — PTC end of conversion
40 PTC_WCOMP — PTC window comparator interrupt
41 SPI1_STC — SPI1 Serial Transfer Complete
42 TWI1 — 2-wire Serial Interface 1
43 TIMER4_CAPT — Timer/Counter4 Capture Event
44 TIMER4_COMPA — Timer/Counter4 Compare Match A
45 TIMER4_COMPB — Timer/Counter4 Compare Match B
46 TIMER4_OVF — Timer/Counter4 Overflow
47 USART2_RX — USART2 Rx Complete
48 USART2_UDRE — USART2 Data register Empty
49 USART2_TX — USART2 Tx Complete
50 USART2_RXS — USART2 RX start edge detect
50 USART2_START — USART2 RX start edge detect

## Properties
SIGNATURES: JTAGID=0x0951703F, SIGNATURE0=0x1e, SIGNATURE1=0x95, SIGNATURE2=0x17
OCD: OCD_REVISION=3, OCD_DATAREG=0x31, PROGBASE=0x0000

## Pinouts (pin number, pad)
TQFP44, VQFN44: 1 PB5, 2 PB6, 3 PB7, 4 RESET, 5 VCC, 6 GND, 7 PE0, 8 PE1, 9 PD0, 10 PD1, 11 PD2, 12 PD3, 13 PD4, 14 PD5, 15 PD6, 16 PD7, 17 PE2, 18 PE3, 19 PC0, 20 PC1, 21 PC2, 22 PC3, 23 PC4, 24 PC5, 25 PC6, 26 PC7, 27 AVCC, 28 GND, 29 PE4, 30 PA7, 31 PA6, 32 PA5, 33 PA4, 34 PA3, 35 PA2, 36 PA1, 37 PA0, 38 PE5, 39 PE6, 40 PB0, 41 PB1, 42 PB2, 43 PB3, 44 PB4
